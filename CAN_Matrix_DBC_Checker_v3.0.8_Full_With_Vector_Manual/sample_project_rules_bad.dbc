VERSION ""
NS_ :

BS_:
BU_: BCM VCU

BO_ 1280 NM_Test: 8 BCM
 SG_ NM_Data : 0|8@1+ (1,0) [0|255] "" VCU
BO_ 1789 XCP_Test: 8 BCM
 SG_ XCP_Data : 0|8@1+ (1,0) [0|255] "" VCU
BO_ 768 CANFD_Bad: 10 BCM
 SG_ FD_Data : 0|8@1+ (1,0) [0|255] "" VCU
BO_ 769 Default_Cyclic: 8 BCM
 SG_ Default_Data : 0|8@1+ (1,0) [0|255] "" VCU
BO_ 770 Node_Ref_Bad: 8 BCM
 SG_ Node_Data : 0|8@1+ (1,0) [0|255] "" MissingNode

BA_DEF_ BO_ "GenMsgSendType" ENUM "Cyclic","Event","NotUsed";
BA_DEF_ BO_ "GenMsgCycleTime" INT 0 65535;
BA_DEF_ BO_ "NmMessage" ENUM "No","Yes";
BA_DEF_ BO_ "VFrameFormat" ENUM "StandardCAN","StandardCAN_FD";
BA_DEF_DEF_ "GenMsgSendType" "Cyclic";
BA_DEF_DEF_ "GenMsgCycleTime" 10;
BA_DEF_DEF_ "VFrameFormat" "StandardCAN";

BA_ "GenMsgSendType" BO_ 1280 1;
BA_ "GenMsgCycleTime" BO_ 1280 0;
BA_ "NmMessage" BO_ 1280 1;
BA_ "GenMsgSendType" BO_ 1789 1;
BA_ "GenMsgCycleTime" BO_ 1789 0;
BA_ "GenMsgCycleTime" BO_ 768 20;
BA_ "VFrameFormat" BO_ 768 1;
BA_ "UnknownAttr" BO_ 770 1;
